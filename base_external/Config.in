## base_external/configs/aesd_qemu_defconfig
```kconfig
BR2_x86_64=y

# Toolchain
BR2_TOOLCHAIN_BUILDROOT_GLIBC=y

# Kernel headers (must match kernel version)
BR2_KERNEL_HEADERS_6_6=y
BR2_KERNEL_HEADERS_VERSION="6.6.32"

# Linux kernel
BR2_LINUX_KERNEL=y
BR2_LINUX_KERNEL_CUSTOM_VERSION=y
BR2_LINUX_KERNEL_CUSTOM_VERSION_VALUE="6.6.32"

# Use kernel defconfig + fragment
BR2_LINUX_KERNEL_USE_DEFCONFIG=y
BR2_LINUX_KERNEL_DEFCONFIG="x86_64"
BR2_LINUX_KERNEL_CONFIG_FRAGMENT_FILES="board/aesd/linux-fragment.config"

# Init system
BR2_INIT_BUSYBOX=y

# AESD overlay and scripts (paths relative to buildroot/)
BR2_ROOTFS_OVERLAY="../base_external/board/aesd/overlay"
BR2_ROOTFS_POST_BUILD_SCRIPT="../base_external/board/aesd/post-build.sh"
BR2_ROOTFS_POST_IMAGE_SCRIPT="../base_external/board/aesd/post-image.sh"

# Networking
BR2_SYSTEM_DHCP="eth0"

# Filesystem
BR2_TARGET_ROOTFS_EXT2=y
BR2_TARGET_ROOTFS_EXT2_4=y
BR2_TARGET_ROOTFS_EXT2_SIZE="120M"

# Your package
BR2_PACKAGE_AESD_ASSIGNMENTS=y
BR2_LINUX_KERNEL_CONFIG_FRAGMENT_FILES="$(BR2_EXTERNAL)/board/aesd/linux-fragment.config"
```

## base_external/package/Config.in
```kconfig
menu "AESD assignment packages"

source "$BR2_EXTERNAL/package/aesd-assignments/Config.in"
source "$BR2_EXTERNAL/package/ldd/Config.in"

endmenu
```
